// SPDX-License-Identifier: GPL-2.0
/**
 * DT overlay for SERDES personality card: 2lane PCIe + USB2.0 Host on AM654 EVM
 *
 * Copyright (C) 2018 Texas Instruments Incorporated - http://www.ti.com/
 */

/dts-v1/;
/plugin/;


/ {
   fragment@101 {
	target-path = "/";

	__overlay__ {
		model = "Texas Instruments AM654 Base Board -- overriden model property";
	};
   };
};
